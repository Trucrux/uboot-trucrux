## board/Trucrux/imx8mm_trucrux/Kconfig
```kconfig
if TARGET_IMX8MM_TRUCRUX

config SYS_BOARD
	default "imx8mm_trucrux"

config SYS_VENDOR
	default "Trucrux"

config SYS_CONFIG_NAME
	default "imx8mm_trucrux"

source "board/freescale/common/Kconfig"

endif
```

## board/Trucrux/imx8mq_trucrux/Kconfig
```kconfig
if TARGET_IMX8MQ_TRUCRUX

config SYS_BOARD
	default "imx8mq_trucrux"

config SYS_VENDOR
	default "Trucrux"

config SYS_CONFIG_NAME
	default "imx8mq_trucrux"

source "board/freescale/common/Kconfig"

endif
```

## board/trucrux/imx8mm_trux/Kconfig
```kconfig
if TARGET_IMX8MM_TRUX

config SYS_BOARD
	default "imx8mm_trux"

config SYS_VENDOR
	default "trucrux"

config SYS_CONFIG_NAME
	default "imx8mm_trux"

source "board/freescale/common/Kconfig"

endif
```

## board/trucrux/imx8mq_trux/Kconfig
```kconfig
if TARGET_IMX8MQ_TRUX

config SYS_BOARD
	default "imx8mq_trux"

config SYS_VENDOR
	default "trucrux"

config SYS_CONFIG_NAME
	default "imx8mq_trux"

source "board/freescale/common/Kconfig"

endif
```
